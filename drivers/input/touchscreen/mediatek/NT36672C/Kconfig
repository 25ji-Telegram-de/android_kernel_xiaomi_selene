## drivers/input/touchscreen/mediatek/NT36672C/Kconfig
```kconfig
#
# Novatek NT36xxx touchscreen driver configuration
#
config TOUCHSCREEN_NT36672C
	bool "Novatek NT36xxx host download SPI driver"
	default n
	help
	  Say Y here if you have a Novatek NT36xxx no flash touchscreen connected
	  to your system by SPI bus.

	  If unsure, say N.

if TOUCHSCREEN_NT36672C

config TOUCHSCREEN_NT36672C_MP
	bool "Novatek NT36672C host download SPI driver - multipoint test"
	default n
	help
	  Say Y here if you want to run multipoint test on NT36672C.

	  If unsure, say N.

endif
```
